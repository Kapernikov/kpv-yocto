## conf/bblayers.conf
```bitbake
# POKY_BBLAYERS_CONF_VERSION is increased each time build/conf/bblayers.conf
# changes incompatibly
POKY_BBLAYERS_CONF_VERSION = "2"

BBPATH = "${TOPDIR}"
BBFILES ?= ""

BBLAYERS ?= " \
  /home/kervel/projects/yocto/poky/meta \
  /home/kervel/projects/yocto/poky/meta-poky \
  /home/kervel/projects/yocto/poky/meta-yocto-bsp \
  "
```

## meta-kapernikov/conf/distro/kapernikov.conf
```bitbake
DISTRO_NAME = "kapernikov"
DISTRO_VERSION = "0.1"

INIT_MANAGER = "systemd"

PACKAGE_CLASSES="package_deb"
DISTRO_FEATURES="acl ext2 ipv4 ipv6 usbgadget usbhost wifi xattr nfs zeroconf pci 3g nfc vfat seccomp ptest multiarch systemd usrmerge virtualization e2fsprogs"
IMAGE_FEATURES:append=" allow-empty-password allow-root-login empty-root-password"


## TCLIBC = "musl"
TCLIBC = "glibc"

VIRTUAL-RUNTIME_container_runtime = "crun"
IMAGE_INSTALL:append = "  podman podman-compose crun cgroup-lite \
                          procps ca-certificates python3-setuptools \
                          python3-pyyaml python3-json htop tmux vim less btrfs-tools swupdate swupdate-www grub-editenv  post-swupdate-healthcheck"

PACKAGE_EXCLUDE:append = " runc runc-opencontainers virtual-runc"
IMAGE_INSTALL:remove = "runc runc-opencontainers virtual-runc"
IMAGE_FSTYPES:append = " ext4.gz wic"
```

## meta-kapernikov/conf/layer.conf
```bitbake
# We have a conf and classes directory, add to BBPATH
BBPATH .= ":${LAYERDIR}"

# We have recipes-* directories, add to BBFILES
BBFILES += "${LAYERDIR}/recipes-*/*/*.bb \
            ${LAYERDIR}/recipes-*/*/*.bbappend"

BBFILE_COLLECTIONS += "meta-kapernikov"
BBFILE_PATTERN_meta-kapernikov = "^${LAYERDIR}/"
BBFILE_PRIORITY_meta-kapernikov = "6"

LAYERDEPENDS_meta-kapernikov = "core"
LAYERSERIES_COMPAT_meta-kapernikov = "scarthgap"
```

## meta-kapernikov/recipes-core/images/kpv.wks
```
part /boot --source bootimg-pcbios --size 256 --fstype=vfat --label bootA --align 1024 --active
part / --source rootfs --size 2500 --fstype=ext4 --label rootfsA
part /boot --source bootimg-pcbios --size 256 --fstype=vfat --label bootB --align 1024
part / --source rootfs --size 2500 --fstype=ext4 --label rootfsB
part /data --size 1024 --fstype=btrfs --label data
bootloader --ptable gpt --timeout=0  --append="rw oprofile.timer=1 rootfstype=ext4 console=tty console=ttyS0 "
```

## meta-swupdate-grubconfig/conf/layer.conf
```bitbake
# We have a conf and classes directory, add to BBPATH
BBPATH .= ":${LAYERDIR}"

# We have recipes-* directories, add to BBFILES
BBFILES += "${LAYERDIR}/recipes-*/*/*.bb \
            ${LAYERDIR}/recipes-*/*/*.bbappend"

BBFILE_COLLECTIONS += "meta-swupdate-grubconfig"
BBFILE_PATTERN_meta-swupdate-grubconfig = "^${LAYERDIR}/"
BBFILE_PRIORITY_meta-swupdate-grubconfig = "6"

LAYERDEPENDS_meta-swupdate-grubconfig = "core"
LAYERSERIES_COMPAT_meta-swupdate-grubconfig = "scarthgap"
```
